## main/Kconfig.projbuild
```kconfig
menu "IOTA Cashier"

    menu "WiFi"
        config WIFI_SSID
            string "WiFi SSID"
            default "myssid"
            help
                SSID (network name) for the example to connect to.

        config WIFI_PASSWORD
            string "WiFi Password"
            default "mypassword"
            help
                WiFi password (WPA or WPA2) for the example to use.
    endmenu

    menu "SNTP"
        config SNTP_SERVER
            string "SNTP server"
            default "pool.ntp.org"
            help
                Endpoint of Network Time Protocol server.

        config SNTP_TZ
            string "Timezone"
            default "CST-8"
            help
                POSIX timezone. Ref: https://github.com/nayarsystems/posix_tz_db/blob/master/zones.json
    endmenu

    menu "IRI Node"
        config IRI_NODE_URI
            string "IRI Node URI"
            default "nodes.thetangle.org"
            help
                IRI uri for the example to use.

        config IRI_NODE_PORT
            int "Port Number of IRI Node"
            default 443
            help
                IRI port for the example to use.

        config ENABLE_HTTPS
            bool "Use HTTPS"
            default y

    endmenu

   config INTERVAL
        int "Monitor interval(s)"
        default 30
        help
            Monitoring interval in seconds.

    config ADDRESS_REFRESH
        bool "Auto refresh address"
        default n
        help
            Refresh address if it's a spent address.

    config IOTA_SEED
        string "Seed"
        default ""
        depends on ADDRESS_REFRESH
        help
            IOTA Seed

    config IOTA_SECURITY
        int "Security Level"
        default 2
        range 1 3
        depends on ADDRESS_REFRESH
        help
            the security level(1, 2, or 3) for addresses generation

    config IOTA_ADDRESS_START_INDEX
        int "Start Address"
        default 0
        depends on ADDRESS_REFRESH
        help
            the start index for finding an unspent address.

    if !ADDRESS_REFRESH
    config IOTA_RECEIVER
        string "Receiver address"
        default ""
        help
            Monitor the balance on this address.
    endif

    config FTF_LCD
        bool "Support LCD"
        default n
        help
            Support QR Code on LCD.

    config CCLIENT_DEBUG
        bool "Enable DEBUG in CClient"
        default n

    choice FLEX_TRIT_ENCODING
        prompt "flex_trit encoding"
        default THREE_TRIT_PER_BYTE
        help
            flex_trit encoding for the trinary module.

        config ONE_TRIT_PER_BYTE
            bool "1 trit per byte"
        config THREE_TRIT_PER_BYTE
            bool "3 trits per byte"
        config FOUR_TRIT_PER_BYTE
            bool "4 trits per byte"
        config FIVE_TRIT_PER_BYTE
            bool "5 trits per byte"
    endchoice

endmenu
```
